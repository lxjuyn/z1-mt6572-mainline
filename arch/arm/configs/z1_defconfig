## drivers/soc/mediatek/Kconfig
```kconfig
# SPDX-License-Identifier: GPL-2.0-only
#
# MediaTek SoC drivers
#
menu "MediaTek SoC drivers"
	depends on ARCH_MEDIATEK || COMPILE_TEST

config MTK_CMDQ
	tristate "MediaTek CMDQ Support"
	depends on ARCH_MEDIATEK || COMPILE_TEST
	select MAILBOX
	select MTK_CMDQ_MBOX
	select MTK_INFRACFG
	help
	  Say yes here to add support for the MediaTek Command Queue (CMDQ)
	  driver. The CMDQ is used to help read/write registers with critical
	  time limitation, such as updating display configuration during the
	  vblank.

config MTK_DEVAPC
	tristate "Mediatek Device APC Support"
	help
	  Say yes here to enable support for Mediatek Device APC driver.
	  This driver is mainly used to handle the violation which catches
	  unexpected transaction.
	  The violation information is logged for further analysis or
	  countermeasures.

config MTK_DVFSRC
	tristate "MediaTek DVFSRC Support"
	depends on ARCH_MEDIATEK
	help
	  Say yes here to add support for the MediaTek Dynamic Voltage
	  and Frequency Scaling Resource Collector (DVFSRC): a HW
	  IP found on many MediaTek SoCs, which is responsible for
	  collecting DVFS requests from various SoC IPs, other than
	  software, and performing bandwidth scaling to provide the
	  best achievable performance-per-watt.

config MTK_INFRACFG
	bool "MediaTek INFRACFG Support"
	select REGMAP
	help
	  Say yes here to add support for the MediaTek INFRACFG controller. The
	  INFRACFG controller contains various infrastructure registers not
	  directly associated to any device.

config MTK_PMIC_WRAP
	tristate "MediaTek PMIC Wrapper Support"
	depends on RESET_CONTROLLER
	depends on OF
	select REGMAP
	help
	  Say yes here to add support for MediaTek PMIC Wrapper found
	  on different MediaTek SoCs. The PMIC wrapper is a proprietary
	  hardware to connect the PMIC.

config MTK_PMIC_WRAP_Z1_WRITE_DENY
	bool "JBO Z1 MT6323 PMIC write-deny diagnostics"
	depends on MTK_PMIC_WRAP
	default n
	help
	  Diagnostic-only safety gate for the JBO Z1 (MT6572 with MT6323).
	  When enabled, the PMIC wrapper still permits reads but rejects and
	  logs every serial PMIC write before it reaches the hardware. This is
	  intended for read-only bring-up and validation, not normal operation.

	  Read-only in-kernel diagnostics are exported as
	  mtk_pmic_wrap_z1_write_deny_active() and
	  mtk_pmic_wrap_z1_write_deny_count().

config MTK_REGULATOR_COUPLER
	bool "MediaTek SoC Regulator Coupler" if COMPILE_TEST
	default ARCH_MEDIATEK
	depends on REGULATOR

config MTK_MT6572_CONNSYS
	tristate "MediaTek MT6572 CONNSYS platform driver"
	depends on ARCH_MEDIATEK
	depends on MTK_SCPSYS_PM_DOMAINS
	depends on REGULATOR
	help
	  Say y here to enable the platform-layer power-on driver for the
	  MT6572 SoC-integrated CONNSYS connectivity block (WiFi + BT), used
	  on boards such as the JBO Z1.  It sequences the MT6323 VCN18/VCN28
	  regulators, powers up the CONN SCPSYS power domain, reads the
	  CONNSYS chip ID and clears the CONNSYS shared EMI carveout.

	  This is a bring-up skeleton: WMT/STP, BTIF and the WLAN AHB HIF are
	  not yet implemented.

config MTK_MMSYS
	tristate "MediaTek MMSYS Support"
	default ARCH_MEDIATEK
	depends on HAS_IOMEM
	depends on MTK_CMDQ || MTK_CMDQ=n
	help
	  Say yes here to add support for the MediaTek Multimedia
	  Subsystem (MMSYS).

config MTK_SVS
	tristate "MediaTek Smart Voltage Scaling(SVS)"
	depends on NVMEM_MTK_EFUSE && NVMEM
	help
	  The Smart Voltage Scaling(SVS) engine is a piece of hardware
	  which has several controllers(banks) for calculating suitable
	  voltage to different power domains(CPU/GPU/CCI) according to
	  chip process corner, temperatures and other factors. Then DVFS
	  driver could apply SVS bank voltage to PMIC/Buck.

config MTK_SOCINFO
	tristate "MediaTek SoC Information"
	default y
	depends on NVMEM_MTK_EFUSE
	select SOC_BUS
	help
	  The MediaTek SoC Information (mtk-socinfo) driver provides
	  information about the SoC to the userspace including the
	  manufacturer name, marketing name and soc name.

endmenu
```

## sound/soc/mediatek/mt6572/Kconfig
```kconfig
# SPDX-License-Identifier: GPL-2.0-only

config SND_SOC_MT6572
	tristate "ASoC support for the MediaTek MT6572 chip"
	depends on ARCH_MEDIATEK || COMPILE_TEST
	select SND_SOC_MEDIATEK
	help
	  This adds the ASoC platform (AFE) driver for the MediaTek MT6572
	  SoC. Select a machine driver below to build a sound card.
	  Select Y if you have such a device. If unsure select "N".

config SND_SOC_MT6572_MT6323
	tristate "ASoC machine driver for MT6572 with the MT6323 codec"
	depends on SND_SOC_MT6572
	select SND_SOC_MT6323
	imply SND_SOC_SIMPLE_AMPLIFIER
	help
	  This adds the ASoC machine driver for a MediaTek MT6572 board with
	  the on-PMIC MT6323 analog audio codec: DL1 playback, headphone-jack
	  detection and an optional external speaker amplifier.
	  Select Y if you have such a device. If unsure select "N".
```
